/*
 * Copyright (c) 2022 The ZMK Contributors
 *
 * SPDX-License-Identifier: MIT
 */

&kscan0 {
        row-gpios
            = <&pro_micro 19 GPIO_ACTIVE_HIGH>
            , <&pro_micro 20 GPIO_ACTIVE_HIGH>
            , <&pro_micro 9 GPIO_ACTIVE_HIGH>
            , <&pro_micro 15 GPIO_ACTIVE_HIGH>
            ;

    };
